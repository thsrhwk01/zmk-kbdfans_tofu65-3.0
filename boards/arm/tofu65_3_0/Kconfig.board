## boards/arm/tofu65_3_0/Kconfig.board
```kconfig
config BOARD_TOFU65_3_0
    bool "KBDfans TOFU65 3.0 wired UniCore-F1"
    depends on SOC_STM32F103XB
```

## boards/arm/tofu65_3_0/Kconfig.defconfig
```kconfig
if BOARD_TOFU65_3_0

config BOARD
    default "tofu65_3_0"

config ZMK_KEYBOARD_NAME
    default "TOFU65 3.0 ZMK"

config ZMK_USB
    default y

endif
```

## dts/bindings/behaviors/kbdfans,unicore-bootloader.yaml
```yaml
description: Request the preserved UniCore-F1 UF2 bootloader through its RAM marker
compatible: "kbdfans,unicore-bootloader"
include: zero_param.yaml
```

## dts/bindings/kscan/kbdfans,unicore-serial.yaml
```yaml
description: TOFU65 UniCore-F1 PB12 clock and bidirectional PB13 serial key scanner
compatible: "kbdfans,unicore-serial"
include: kscan.yaml
properties:
  poll-interval-ms:
    type: int
    default: 1
  half-period-us:
    type: int
    default: 1
  settle-us:
    type: int
    default: 2
```

## zephyr/Kconfig
```kconfig
config TOFU65_UNICORE
    bool "TOFU65 UniCore-F1 serial scanner"
    default y if BOARD_TOFU65_3_0
    depends on SOC_STM32F103XB

config TOFU65_USB_DIAGNOSTIC
    bool "Enumerate USB without periodic key scanning (diagnostic only)"
    depends on TOFU65_UNICORE
    default n
    help
      Keep the normal HID descriptors and initial GPIO setup but never start
      the serial scan worker. Keys cannot type in this diagnostic build.
```
