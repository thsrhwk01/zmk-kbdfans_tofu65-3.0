/* Generated by tools/generate_layout.py. All stock switch positions. */
/ {
    tofu_transform: matrix_transform {
        compatible = "zmk,matrix-transform";
        rows = <14>;
        columns = <8>;
        map = <
            RC(0,0) /* ESC */
            RC(0,4) /* 1 */
            RC(0,5) /* 2 */
            RC(0,6) /* 3 */
            RC(2,0) /* 4 */
            RC(2,2) /* 5 */
            RC(2,4) /* 6 */
            RC(2,5) /* 7 */
            RC(4,0) /* 8 */
            RC(4,2) /* 9 */
            RC(4,3) /* 0 */
            RC(4,4) /* MINUS */
            RC(6,0) /* EQUAL */
            RC(6,1) /* BACKSPACE */
            RC(6,3) /* DELETE */
            RC(0,1) /* TAB */
            RC(0,2) /* Q */
            RC(0,3) /* W */
            RC(0,7) /* E */
            RC(2,1) /* R */
            RC(2,3) /* T */
            RC(2,6) /* Y */
            RC(2,7) /* U */
            RC(4,1) /* I */
            RC(4,5) /* O */
            RC(4,6) /* P */
            RC(4,7) /* LBRACKET */
            RC(6,4) /* RBRACKET */
            RC(6,5) /* BACKSLASH */
            RC(8,0) /* PGUP */
            RC(1,7) /* CAPS */
            RC(1,6) /* A */
            RC(1,2) /* S */
            RC(3,7) /* D */
            RC(3,6) /* F */
            RC(3,1) /* G */
            RC(5,7) /* H */
            RC(5,6) /* J */
            RC(5,5) /* K */
            RC(5,0) /* L */
            RC(7,7) /* SEMICOLON */
            RC(7,4) /* APOSTROPHE */
            RC(7,0) /* ENTER */
            RC(9,2) /* PGDN */
            RC(1,5) /* LSHIFT */
            RC(1,0) /* Z */
            RC(3,5) /* X */
            RC(3,3) /* C */
            RC(3,2) /* V */
            RC(3,0) /* B */
            RC(5,4) /* N */
            RC(5,2) /* M */
            RC(5,1) /* COMMA */
            RC(7,6) /* DOT */
            RC(7,5) /* SLASH */
            RC(9,7) /* RSHIFT */
            RC(9,6) /* UP */
            RC(9,3) /* END */
            RC(1,3) /* LCTRL */
            RC(1,1) /* LGUI */
            RC(3,4) /* LALT */
            RC(5,3) /* SPACE */
            RC(7,3) /* RALT */
            RC(7,2) /* RGUI */
            RC(7,1) /* LEFT */
            RC(9,5) /* DOWN */
            RC(9,4) /* RIGHT */
            RC(6,2) /* SPLIT_BACKSPACE_EXTRA */
            RC(1,4) /* SPLIT_LSHIFT_EXTRA */
        >;
    };
};
